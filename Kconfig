## Kconfig
```kconfig
mainmenu "Shadow Engine Build Configuration"

config SHADOW_DEBUG
	bool "Debug Build"
	default true
	help
	  Compiles Shadow Engine in debug mode

config INCLUDE_BUILD_SYMBOLS
	bool "Include Build Symbols"
	default true
	depends on SHADOW_DEBUG
	help
	  Symbols are automatically disabled for release
	  builds

config CROSS_COMPILE
	string "Cross-compiler Prefix"
	help
	  Sets the prefix used for cross-compiling,
	  works the same as 'make CROSS_COMPILE=test-prefix-'

config PRETTY_NAME
	string "Engine Name"
	default "Shadow Engine"
	help
	  A pretty-printed name for the game engine

config LOCAL_VERSION
	string "Local Version"
	default ""
	help
	  A version name appended to the engine release number
	  to help organize versions further. (Do not include a
	  '-' at the start)

config OUTPUT_BINARY_NAME
	string "Output Binary Name"
	default "game"
	help
	  The file name of the binary produced by the build
	  system

choice
	prompt "Platform"
	default SHADOW_PLATFORM_LINUX_64
	help
	  The platform that Shadow Engine will compile to

config SHADOW_PLATFORM_LINUX_64
	bool "Linux x86_64"

config SHADOW_PLATFORM_LINUX_AARCH64
	bool "Linux aarch64"

config SHADOW_PLATFORM_WINDOWS_64
	bool "Windows x86_64"

config SHADOW_PLATFORM_ANDROID_AARCH64
	bool "Android aarch64"

config SHADOW_PLATFORM_MACOS_ARM
	bool "MacOS ARM"

config SHADOW_PLATFORM_MACOS_64
	bool "MacOS x86_64"

config SHADOW_PLATFORM_IOS_ARM
	bool "IOS ARM"

config SHADOW_PLATFORM_PLAYSTATION
	bool "PlayStation"

config SHADOW_PLATFORM_UWP
	bool "Xbox UWP"

endchoice

choice
	prompt "Graphics Library"
	default SHADOW_GL_VULKAN
	help
	  The graphics library that will be used to interact
	  with the hardware

config SHADOW_GL_NONE
	bool "None"

config SHADOW_GL_VULKAN
	bool "Vulkan"
	depends on SHADOW_PLATFORM_LINUX_64 || SHADOW_PLATFORM_LINUX_AARCH64 || SHADOW_PLATFORM_ANDROID_AARCH64 || SHADOW_PLATFORM_WINDOWS_64

config SHADOW_GL_DIRECTX_12
	bool "DirectX 12"
	depends on SHADOW_PLATFORM_WINDOWS_64 || SHADOW_PLATFORM_UWP

config SHADOW_GL_OPENGL
	bool "OpenGL"
	depends on SHADOW_PLATFORM_LINUX_64 || SHADOW_PLATFORM_LINUX_AARCH64 || SHADOW_PLATFORM_ANDROID_AARCH64 || SHADOW_PLATFORM_WINDOWS_64 || SHADOW_PLATFORM_IOS_ARM || SHADOW_PLATFORM_MACOS_64 || SHADOW_PLATFORM_MACOS_ARM

config SHADOW_GL_METAL
	bool "Metal"
	depends on SHADOW_PLATFORM_IOS_ARM || SHADOW_PLATFORM_MACOS_64 || SHADOW_PLATFORM_MACOS_ARM

config SHADOW_GL_GNM
	bool "GNM"
	depends on SHADOW_PLATFORM_PLAYSTATION

endchoice
```
